## firmware/components/ksbridge/Kconfig
```kconfig
menu "KS light bridge"

    config KSA_NAME_PREFIX
        string "Only claim lamps whose name starts with (empty = any known lamp)"
        default ""
        help
            Claiming only considers lamps from a known family (Triones/HappyLighting
            or KS). Set this to narrow it further, e.g. "Triones" or a full name.

    config KSA_TARGET_ADDR
        string "Pin one lamp by BLE address (aa:bb:cc:dd:ee:ff), empty = any"
        default ""

    config KSA_DEBUG_NO_USB
        bool "Debug: skip USB, cycle colors and fake agent signals"
        default n
        help
            Keeps the USB serial/JTAG console alive (TinyUSB normally takes the
            USB port), so you can watch logs with idf.py monitor and confirm the
            Bluetooth half and the screen work before involving RDP.

    menu "T-Dongle-S3 board"
        # Defaults from LILYGO's examples (Xinyuan-LilyGO/T-Dongle-S3).

        config KSA_LCD_ENABLE
            bool "Drive the 0.96\" ST7735 screen"
            default y

        choice KSA_LCD_ORIENTATION
            prompt "Screen orientation"
            depends on KSA_LCD_ENABLE
            default KSA_LCD_PORTRAIT
            config KSA_LCD_PORTRAIT
                bool "Portrait 80x160 (dongle standing, plug away from you)"
            config KSA_LCD_LANDSCAPE
                bool "Landscape 160x80"
        endchoice

        config KSA_LCD_FLIP
            bool "Rotate the screen 180 degrees (if Lumi is upside down)"
            depends on KSA_LCD_ENABLE
            default n
            help
                Portrait should put the top of the screen at the USB plug. Which
                way that is depends on how the panel is mounted, so if Lumi comes
                up upside down on your unit, turn this on.
        config KSA_LCD_MOSI
            int "LCD MOSI"
            depends on KSA_LCD_ENABLE
            default 3
        config KSA_LCD_SCLK
            int "LCD SCLK"
            depends on KSA_LCD_ENABLE
            default 5
        config KSA_LCD_CS
            int "LCD CS"
            depends on KSA_LCD_ENABLE
            default 4
        config KSA_LCD_DC
            int "LCD DC"
            depends on KSA_LCD_ENABLE
            default 2
        config KSA_LCD_RST
            int "LCD RST"
            depends on KSA_LCD_ENABLE
            default 1
        config KSA_LCD_BL
            int "LCD backlight (active low)"
            depends on KSA_LCD_ENABLE
            default 38

        config KSA_LED_ENABLE
            bool "Drive the APA102 RGB LED"
            default y
        config KSA_LED_DATA_GPIO
            int "APA102 data"
            depends on KSA_LED_ENABLE
            default 40
        config KSA_LED_CLK_GPIO
            int "APA102 clock"
            depends on KSA_LED_ENABLE
            default 39

        config KSA_BUTTON_GPIO
            int "Acknowledge button (BOOT), -1 = none"
            default 0
    endmenu

endmenu
```

## firmware/main/Kconfig.projbuild
```kconfig
menu "KS audio bridge"

    config KSA_NAME_PREFIX
        string "Only connect to lamps whose name starts with"
        default "KS"
        help
            Any advertised name matching a known KS profile AND this prefix is
            used. Narrow it (e.g. "KS03~1A2B") if several lamps are in range.

    config KSA_TARGET_ADDR
        string "Pin one lamp by BLE address (aa:bb:cc:dd:ee:ff), empty = any"
        default ""

    config KSA_DEBUG_NO_USB
        bool "Debug: skip USB audio, cycle colors every 4 s"
        default n
        help
            Keeps the USB serial/JTAG console alive (TinyUSB normally takes the
            USB port), so you can watch logs with idf.py monitor and confirm the
            Bluetooth half works before involving RDP.

    config KSA_LED_ENABLE
        bool "Drive the onboard APA102 status LED"
        default y

    config KSA_LED_DATA_GPIO
        int "APA102 data GPIO"
        depends on KSA_LED_ENABLE
        default 40

    config KSA_LED_CLK_GPIO
        int "APA102 clock GPIO"
        depends on KSA_LED_ENABLE
        default 39

endmenu
```
